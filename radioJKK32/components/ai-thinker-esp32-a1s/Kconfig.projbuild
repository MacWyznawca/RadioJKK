## radioJKK32/components/ai-thinker-esp32-a1s/Kconfig.projbuild
```kconfig
menu "Custom Audio Board"

choice CUSTOM_AUDIO_BOARD
    prompt "Select a custom audio board"
    default AI_THINKER_ESP32_A1S_ES8388_VARIANT_5
    help
        Select an audio board to use with the ESP-ADF

    # TODO add more variants, see https://github.com/pschatzmann/arduino-audiokit/tree/main/src/audio_board
    config AI_THINKER_ESP32_A1S_ES8388_VARIANT_7
        bool "Ai Thinker ESP32 A1S Audio Kit (ES8388, variant 7)"
    config AI_THINKER_ESP32_A1S_ES8388_VARIANT_5
        bool "Ai Thinker ESP32 A1S Audio Kit (ES8388, variant 5)"
endchoice

choice
    prompt "Select button type"
    default AI_THINKER_ESP32_A1S_ES8388_BUTTON_KEY_GPIO
    help
        The board supports two type of buttons; GPIO or ADC.

        With GPIO type, key inputs are handled by GPIO pins.

        With ADC type, key inputs are handled by a single ADC pin. However,
        the board must have necessary resistors (R60 - R64) soldered. Check
        the board first.
    config AI_THINKER_ESP32_A1S_ES8388_BUTTON_KEY_GPIO
        bool "Use GPIO pins for key inputs"
    config AI_THINKER_ESP32_A1S_ES8388_BUTTON_KEY_ADC
        bool "Use an ADC pin for key inputs (don't work if resistors are not soldered)"
endchoice

config AI_THINKER_ESP32_A1S_AUDIO_KIT_USING_SDCARD
    bool "Use on-board SD card"
    default y
    help
        Choose y to use on-board SD card.
endmenu
```

## radioJKK32/main/Kconfig.projbuild
```kconfig
menu "RadioJKK Configuration"


	config WIFI_SSID
		string "WiFi SSID"
		default "myssid"
		help
			SSID (network name) for the example to connect to.
			Use 'settings.txt' in main folder of SD card to set the ssid at runtime in csv (separated by semicolon) format:
			
			myssid;mypassword
			
			Note: If the ssid is set in 'settings.txt', it will override this value
			and the example will use the ssid from 'settings.txt'.

	config WIFI_PASSWORD
		string "WiFi Password"
		default "mypassword"
		help
			WiFi password (WPA or WPA2) for the example to use.
			
			Note:  Use 'settings.txt' in main folder of SD card to set the password at runtime in csv (separated by semicolon) format:
			If the password is set in 'settings.txt', it will override this value
			and the example will use the password from 'settings.txt'.
			Can be left blank if the network has no security set.
			
			myssid;mypassword

	config JKK_PROV_TRANSPORT_SOFTAP
		bool "Enable ESP SoftAP"
		default n
		help
			Select to use ESP SoftAP prov application
	
	config JKK_RADIO_USING_EXT_KEYS
		bool "Use External keys"
		default n
		help
			Choose y to use GPIO13 connected to (JT) MTCK as KEY2 and GPIO22 (P2) as KEY1.
			You also can use GPIO19 (P2) as KEY3 and GPIO23 (P2) as KEY4.
			Note: set (S1) [1] GPIO13 off and (S1) [4] GPIO13 set to JT MTCK 

	config JKK_RADIO_USING_I2C_LCD
		bool "Use I2C LCD"
		default n
		help
			Choose y to use i2c LCD (OLED). Settings limited Keypad

	if JKK_RADIO_USING_I2C_LCD
		choice JKK_RADIO_LCD_CONTROLLER
			prompt "LCD controller model"
			default JKK_RADIO_LCD_CONTROLLER_SSD1306
			help
				Select LCD controller model

			config JKK_RADIO_LCD_CONTROLLER_SSD1306
				bool "SSD1306"

			config JKK_RADIO_LCD_CONTROLLER_SH1107
				bool "SH1107"
		endchoice

		if JKK_RADIO_LCD_CONTROLLER_SSD1306
			choice JKK_RADIO_SSD1306_HEIGHT
				prompt "SSD1306 Height in pixels"
				default JKK_RADIO_SSD1306_HEIGHT_64
				help
					Height of the display in pixels. a.k.a vertical resolution

				config JKK_RADIO_SSD1306_HEIGHT_64
					bool "64"
				config JKK_RADIO_SSD1306_HEIGHT_32
					bool "32"
			endchoice

			config JKK_RADIO_SSD1306_HEIGHT
				int
				default 64 if JKK_RADIO_SSD1306_HEIGHT_64
				default 32 if JKK_RADIO_SSD1306_HEIGHT_32
		endif
	endif
endmenu
```

## radioJKK32/sdkconfig.defaults
```kconfig
# Serial flasher config
#
CONFIG_FLASHMODE_QIO=y
CONFIG_ESPTOOLPY_FLASHSIZE_4MB=y
CONFIG_ESPTOOLPY_FLASHFREQ_80M=y

CONFIG_SPIRAM_MALLOC_ALWAYSINTERNAL=1024
CONFIG_SPIRAM_TRY_ALLOCATE_WIFI_LWIP=y
CONFIG_SPIRAM_MALLOC_RESERVE_INTERNAL=40960
CONFIG_SPIRAM_ALLOW_BSS_SEG_EXTERNAL_MEMORY=y
CONFIG_SPIRAM_BANKSWITCH_ENABLE=n

CONFIG_FREERTOS_HZ=1000
CONFIG_FREERTOS_TIMER_TASK_STACK_DEPTH=3200

CONFIG_FREERTOS_ENABLE_BACKWARD_COMPATIBILITY=y

# Custom Audio Board
#
CONFIG_AUDIO_BOARD_CUSTOM=y

CONFIG_AI_THINKER_ESP32_A1S_ES8388_VARIANT_5=y
CONFIG_AI_THINKER_ESP32_A1S_ES8388_BUTTON_KEY_GPIO=y
CONFIG_AI_THINKER_ESP32_A1S_AUDIO_KIT_USING_SDCARD=y


CONFIG_PARTITION_TABLE_CUSTOM=y
CONFIG_PARTITION_TABLE_OFFSET=0x8000
CONFIG_PARTITION_TABLE_CUSTOM_FILENAME="partitions_radiojkk.csv"

CONFIG_ESP_TLS_INSECURE=y
CONFIG_ESP_TLS_SKIP_SERVER_CERT_VERIFY=y

CONFIG_ESP_SYSTEM_EVENT_TASK_STACK_SIZE=3584

CONFIG_LOG_COLORS=y

CONFIG_LWIP_MAX_SOCKETS=20
CONFIG_LWIP_LOCAL_HOSTNAME="radiojkk"
CONFIG_LWIP_DHCPS=y

# CONFIG_BT_ENABLED=n

CONFIG_LV_CONF_SKIP=y
CONFIG_LV_FONT_DEFAULT_UNSCII_8=y
CONFIG_LV_FONT_MONTSERRAT_14=n
CONFIG_LV_FONT_UNSCII_8=y
CONFIG_LV_FONT_UNSCII_16=y
CONFIG_LV_DRAW_SW_COMPLEX=n
CONFIG_LV_USE_OBSERVER=n
CONFIG_LV_USE_SYSMON=n
CONFIG_LV_USE_QRCODE=y
```

## radioJKK32/sdkconfig.defaults.esp32
```kconfig
CONFIG_IDF_CMAKE=y
CONFIG_IDF_TARGET_ARCH_XTENSA=y
CONFIG_IDF_TARGET="esp32"
CONFIG_IDF_TARGET_ESP32=y
CONFIG_IDF_FIRMWARE_CHIP_ID=0x0000

#
# Audio HAL
#
CONFIG_AUDIO_BOARD_CUSTOM=y

#
# ESP32-specific
#
CONFIG_ESP32_DEFAULT_CPU_FREQ_240=y
CONFIG_ESP32_DEFAULT_CPU_FREQ_MHZ=240
CONFIG_FREERTOS_PLACE_FUNCTIONS_INTO_FLASH=y

#
# ESP32-specific
#
CONFIG_SPIRAM=y

#
# SPI RAM config
#
CONFIG_SPIRAM_CACHE_WORKAROUND=n
CONFIG_SPIRAM_BOOT_INIT=y
CONFIG_SPIRAM_USE_MALLOC=y
CONFIG_SPIRAM_IGNORE_NOTFOUND=y
CONFIG_SPIRAM_SPEED_80M=y
CONFIG_SPIRAM_ALLOW_STACK_EXTERNAL_MEMORY=y
CONFIG_SPIRAM_TRY_ALLOCATE_WIFI_LWIP=y

# Override some defaults so BT stack is enabled and
# Classic BT is enabled
# CONFIG_BT_ENABLED=y
# CONFIG_BTDM_CTRL_MODE_BR_EDR_ONLY=y
# CONFIG_BTDM_CONTROLLER_MODE_BR_EDR_ONLY=y
# CONFIG_BTDM_CTRL_PINNED_TO_CORE_1=y
# CONFIG_BLUEDROID_ENABLED=y
# CONFIG_BLUEDROID_PINNED_TO_CORE_1=y
# CONFIG_BLUEDROID_PINNED_TO_CORE=1
# CONFIG_CLASSIC_BT_ENABLED=y
# CONFIG_A2DP_ENABLE=y
# CONFIG_COMPILER_OPTIMIZATION_SIZE=y
# CONFIG_BT_ALLOCATION_FROM_SPIRAM_FIRST=y
# CONFIG_BT_BLE_DYNAMIC_ENV_MEMORY=y
```
